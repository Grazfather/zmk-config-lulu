## boards/shields/lulu/Kconfig.defconfig
```kconfig
# Copyright (c) 2020 Pete Johanson
# SPDX-License-Identifier: MIT

if SHIELD_LULU_LEFT

config ZMK_KEYBOARD_NAME
    default "Lulu"

config ZMK_SPLIT_ROLE_CENTRAL
    default y

endif # SHIELD_LULU_LEFT

if SHIELD_LULU_LEFT || SHIELD_LULU_RIGHT

config ZMK_SPLIT
    default y

endif # SHIELD_LULU_LEFT || SHIELD_LULU_RIGHT
```

## boards/shields/lulu/Kconfig.shield
```kconfig
# Copyright (c) 2020 Pete Johanson
# SPDX-License-Identifier: MIT

config SHIELD_LULU_LEFT
    def_bool $(shields_list_contains,lulu_left)

config SHIELD_LULU_RIGHT
    def_bool $(shields_list_contains,lulu_right)
```
